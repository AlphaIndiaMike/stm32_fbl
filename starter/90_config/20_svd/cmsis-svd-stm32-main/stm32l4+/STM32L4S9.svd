# STM32L4S9 register map
File version: 2.0
CPU: CM4 r0p1, little endian, MPU, FPU, 4 interrupt priority bits
Registers are 32-bit, read-write, reset 0x0 unless marked. A register's access mark holds for its fields unless they carry their own. Offsets are from the block's base; lines under a group give offsets from that group; [hi:lo] are bit positions; {n}, {i} and the like mark numbered series; 'fields as' and 'values as' point back to an identical list; <NAME> marks a mode.

## Memory map
0x40000000 TIM2 size 0x400 — General-purpose-timers
0x40000400 TIM3 size 0x400 — General-purpose-timers
0x40000800 TIM4 size 0x400 — General-purpose-timers
0x40000C00 TIM5 size 0x400 — General-purpose-timers
0x40001000 TIM6 size 0x400 — TIM6 address block description
0x40001400 TIM7 size 0x400 — TIM7 address block description
0x40002800 RTC size 0x400 — Real-time clock
0x40002C00 WWDG size 0x400 — System window watchdog
0x40003000 IWDG size 0x400 — Independent watchdog
0x40003800 SPI2 size 0x400
0x40003C00 SPI3 size 0x400
0x40004400 USART2 size 0x400
0x40004800 USART3 size 0x400
0x40004C00 UART4 size 0x400
0x40005000 UART5 size 0x400
0x40005400 I2C1 size 0x400 — Inter-integrated circuit
0x40005800 I2C2 size 0x400
0x40005C00 I2C3 size 0x400
0x40006000 CRS size 0x400 — Clock recovery system
0x40006400 CAN1 size 0x400 — Controller area network
0x40007000 PWR size 0x400 — Power control
0x40007400 DAC size 0x400 — Digital-to-analog converter
0x40007800 OPAMP size 0x400 — Operational amplifiers
0x40007C00 LPTIM1 size 0x400 — Low power timer
0x40008000 LPUART1 size 0x400 — Universal synchronous asynchronous receiver transmitter
0x40008400 I2C4 size 0x400
0x40008800 SWPMI1 size 0x400 — Single Wire Protocol Master Interface
0x40009400 LPTIM2 size 0x400
0x40010000 SYSCFG size 0x30 — System configuration controller
0x40010030 VREFBUF size 0x1D0 — Voltage reference buffer
0x40010200 COMP size 0x200 — Comparator
0x40010400 EXTI size 0x400 — External interrupt/event controller
0x40011C00 FIREWALL size 0x400
0x40012C00 TIM1 size 0x400 — Advanced-timers
0x40013000 SPI1 size 0x400 — Serial peripheral interface/Inter-IC sound
0x40013400 TIM8 size 0x400 — Advanced-timers
0x40013800 USART1 size 0x400 — Universal synchronous asynchronous receiver transmitter
0x40014000 TIM15 size 0x400 — General purpose timers
0x40014400 TIM16 size 0x400 — General purpose timers
0x40014800 TIM17 size 0x400 — General purpose timers
0x40015400 SAI1 size 0x400 — Serial audio interface
0x40015800 SAI2 size 0x400
0x40016000 DFSDM1 size 0x500 — Digital filter for sigma delta modulators
0x40016800 LTCD size 0x400 — Liquid crystal display controller
0x40016C00 DSI size 0x800 — DSI Host
0x40020000 DMA1 size 0x400 — Direct memory access controller
0x40020400 DMA2 size 0x400
0x40020800 DMAMUX1 size 0x400 — DMA request multiplexer
0x40021000 RCC size 0x400 — Reset and clock control
0x40022000 FLASH size 0x400
0x40023000 CRC size 0x400 — Cyclic redundancy check calculation unit
0x40024000 TSC size 0x400 — Touch sensing controller
0x4002B000 DMA2D size 0xC00 — DMA2D controller
0x4002C000 GFXMMU size 0x3000 — Graphic MMU
0x48000000 GPIOA size 0x400 — General-purpose I/Os
0x48000400 GPIOB size 0x400 — General-purpose I/Os
0x48000800 GPIOC size 0x400 — General-purpose I/Os
0x48000C00 GPIOD size 0x400
0x48001000 GPIOE size 0x400
0x48001400 GPIOF size 0x400
0x48001800 GPIOG size 0x400
0x48001C00 GPIOH size 0x400
0x48002000 GPIOI size 0x400 — General-purpose I/Os
0x50000000 OTG_FS_GLOBAL size 0x400 — USB on the go full speed
0x50000400 OTG_FS_HOST size 0x400 — USB on the go full speed
0x50000800 OTG_FS_DEVICE size 0x400 — USB on the go full speed
0x50000E00 OTG_FS_PWRCLK size 0x400 — USB on the go full speed
0x50040000 ADC size 0xB9 — Analog-to-Digital Converter
0x50040300 ADC_Common size 0x11 — Analog-to-Digital Converter
0x50050000 DCMI size 0x400 — Digital camera interface
0x50060000 AES size 0x400 — Advanced encryption standard hardware accelerator
0x50060400 HASH size 0x400 — Hash processor
0x50060800 RNG size 0x400 — Random number generator
0x50061C00 OCTOSPIM size 0x400 — OctoSPI IO Manager
0x50062400 SDMMC1 size 0x400 — Secure digital input/output interface
0xA0000000 FMC size 0x400 — Flexible memory controller
0xA0001000 OCTOSPI1 size 0x400 — OctoSPI
0xA0001400 OCTOSPI2 size 0x400
0xE000E008 SCB_ACTRL size 0x5 — System control block ACTLR
0xE000E010 STK size 0x11 — SysTick timer
0xE000E100 NVIC size 0x356 — Nested Vectored Interrupt Controller
0xE000ED00 SCB size 0x41 — System control block
0xE000ED88 FPU_CPACR size 0x5 — Floating point unit CPACR
0xE000ED90 MPU size 0x15 — Memory protection unit
0xE000EF00 NVIC_STIR size 0x5 — Nested vectored interrupt controller
0xE000EF34 FPU size 0xD — Floting point unit
0xE0042000 DBGMCU size 0x400 — Debug support

## Interrupts
0 WWDG — Window Watchdog interrupt
1 PVD_PVM (EXTI) — PVD through EXTI line detection
2 TAMP_STAMP (RTC) — Tamper and TimeStamp interrupts
3 RTC_WKUP (RTC) — RTC Tamper or TimeStamp /CSS on LSE through EXTI line 19 interrupts
4 FLASH — Flash global interrupt
5 RCC — RCC global interrupt
6 EXTI0 (EXTI) — EXTI Line 0 interrupt
7 EXTI1 (EXTI) — EXTI Line 1 interrupt
8 EXTI2 (EXTI) — EXTI Line 2 interrupt
9 EXTI3 (EXTI) — EXTI Line 3 interrupt
10 EXTI4 (EXTI) — EXTI Line 4 interrupt
11 DMA1_CH1 (DMA1) — DMA1 Channel1 global interrupt
12 DMA1_CH2 (DMA1) — DMA1 Channel2 global interrupt
13 DMA1_CH3 (DMA1) — DMA1 Channel3 interrupt
14 DMA1_CH4 (DMA1) — DMA1 Channel4 interrupt
15 DMA1_CH5 (DMA1) — DMA1 Channel5 interrupt
16 DMA1_CH6 (DMA1) — DMA1 Channel6 interrupt
17 DMA1_CH7 (DMA1) — DMA1 Channel 7 interrupt
18 ADC1 (ADC) — ADC1 and ADC2 global interrupt
19 CAN1_TX (CAN1) — CAN1 TX interrupts
20 CAN1_RX0 (CAN1) — CAN1 RX0 interrupts
21 CAN1_RX1 (CAN1) — CAN1 RX1 interrupts
22 CAN1_SCE (CAN1) — CAN1 SCE interrupt
23 EXTI9_5 (EXTI) — EXTI Line5 to Line9 interrupts
24 TIM1_BRK_TIM15 (TIM1) — TIM1 Break/TIM15 global interrupts
25 TIM1_UP_TIM16 (TIM1) — TIM1 Update/TIM16 global interrupts
26 TIM1_TRG_COM_TIM17 (TIM1) — TIM1 Trigger and Commutation interrupts and TIM17 global interrupt
27 TIM1_CC (TIM1) — TIM1 Capture Compare interrupt
28 TIM2 — TIM2 global interrupt
29 TIM3 — TIM3 global interrupt
30 TIM4 — TIM4 global interrupt
31 I2C1_EV (I2C1) — I2C1 event interrupt
32 I2C1_ER (I2C1) — I2C1 error interrupt
33 I2C2_EV (I2C2) — I2C2 event interrupt
34 I2C2_ER (I2C2) — I2C2 error interrupt
35 SPI1 — SPI1 global interrupt
36 SPI2 — SPI2 global interrupt
37 USART1 — USART1 global interrupt
38 USART2 — USART2 global interrupt
39 USART3 — USART3 global interrupt
40 EXTI15_10 (EXTI) — EXTI Lines 10 to 15 interrupts
41 RTC_ALARM (RTC) — RTC alarms through EXTI line 18 interrupts
42 DFSDM1_FLT3 (DFSDM1) — DFSDM1_FLT3 global interrupt
43 TIM8_BRK (TIM8) — TIM8 Break Interrupt
44 TIM8_UP (TIM8) — TIM8 Update Interrupt
45 TIM8_TRG_COM (TIM8) — TIM8 Trigger and Commutation Interrupt
46 TIM8_CC (TIM8) — TIM8 Capture Compare Interrupt
47 ADC3 (ADC) — ADC3 global interrupt
48 FMC — FMC global Interrupt
49 SDMMC1 — SDMMC global Interrupt
50 TIM5 — TIM5 global Interrupt
51 SPI3 — SPI3 global Interrupt
52 UART4 — UART4 global Interrupt
53 UART5 — UART5 global Interrupt
54 TIM6_DACUNDER (TIM6) — TIM6 global and DAC1 and 2 underrun error interrupts
55 TIM7 — TIM7 global interrupt
56 DMA2_CH1 (DMA2) — DMA2 Channel 1 global Interrupt
57 DMA2_CH2 (DMA2) — DMA2 Channel 2 global Interrupt
58 DMA2_CH3 (DMA2) — DMA2 Channel 3 global Interrupt
59 DMA2_CH4 (DMA2) — DMA2 Channel 4 global Interrupt
60 DMA2_CH5 (DMA2) — DMA2 Channel 5 global Interrupt
61 DFSDM1_FLT0 (DFSDM1) — DFSDM1_FLT0 global interrupt
62 DFSDM1_FLT1 (DFSDM1) — DFSDM1_FLT1 global interrupt
63 DFSDM1_FLT2 (DFSDM1) — DFSDM1_FLT2 global interrupt
64 COMP — COMP1 and COMP2 interrupts
65 LPTIM1 — LP TIM1 interrupt
66 LPTIM2 — LP TIM2 interrupt
67 OTG_FS (OTG_FS_GLOBAL) — USB OTG FS global Interrupt
68 DMA2_CH6 (DMA2) — DMA2 Channel 6 global Interrupt
69 DMA2_CH7 (DMA2) — DMA2 Channel 7 global Interrupt
70 LPUART1 — LPUART1 global interrupt
71 OCTOSPI1 — OCTOSPI1 global interrupt
72 I2C3_EV (I2C3) — I2C3 event interrupt
73 I2C3_ER (I2C3) — I2C3 error interrupt
74 SAI1 — SAI1 global interrupt
75 SAI2 — SAI2 global interrupt
76 OCTOSPI2 — OCTOSPI2 global interrupt
77 TSC — TSC global interrupt
78 DSIHSOT (DSI) — DSI global interrupt
79 AES — AES global interrupt
80 RNG_HASH (RNG) — RNG and HASH global interrupt
81 FPU (FMC, FPU) — Floating point interrupt
82 CRS — CRS global interrupt
83 I2C4_ER (I2C4) — I2C4 error interrupt
84 I2C4_EV (I2C4) — I2C4 event interrupt
85 DCMI — DCMI global interrupt
90 DMA2D — DMA2D global interrupt
91 LCD_TFT (LTCD) — LTDC global interrupt
92 LCD_TFT_ER (LTCD) — LTDC global error interrupt
93 GFXMMU — GFXMMU global error interrupt
94 DMAMUX_OVR (DMAMUX1) — DMAMUX Overrun interrupt

## Notices in the file
Copyright (c) 2023 STMicroelectronics.
SPDX-License-Identifier: Apache-2.0
Licensed under the Apache License, Version 2.0 (the "License");
you may not use this file except in compliance with the License.
You may obtain a copy of the License at
http://www.apache.org/licenses/LICENSE-2.0
Unless required by applicable law or agreed to in writing, software
distributed under the License is distributed on an "AS IS" BASIS,
WITHOUT WARRANTIES OR CONDITIONS OF ANY KIND, either express or implied.
See the License for the specific language governing permissions and
limitations under the License.
